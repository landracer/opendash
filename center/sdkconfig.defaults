## center/sdkconfig.defaults
```kconfig
# ─────────────────────────────────────────────────────────────────────────────
# OpenDash Center Display — SDK Configuration Defaults
#
# Hardware: Waveshare ESP32-S3-Touch-LCD-4.3
# Resolution: 800×480 IPS LCD
# ─────────────────────────────────────────────────────────────────────────────

#
# Target Configuration
#
CONFIG_IDF_TARGET="esp32s3"

#
# Flash Configuration
#
CONFIG_ESPTOOLPY_FLASHSIZE_16MB=y
CONFIG_ESPTOOLPY_FLASHMODE_QIO=y
CONFIG_ESPTOOLPY_FLASHFREQ_80M=y

#
# Partition Table
#
CONFIG_PARTITION_TABLE_CUSTOM=y
CONFIG_PARTITION_TABLE_CUSTOM_FILENAME="partitions.csv"

#
# ESP32S3-Specific Configuration
#
CONFIG_ESP32S3_DEFAULT_CPU_FREQ_240=y
CONFIG_ESP32S3_DATA_CACHE_64KB=y
CONFIG_ESP32S3_DATA_CACHE_LINE_64B=y

#
# Memory Configuration
#
CONFIG_ESP_MAIN_TASK_STACK_SIZE=8192
CONFIG_SPIRAM=y
CONFIG_SPIRAM_MODE_OCT=y
CONFIG_SPIRAM_SPEED_80M=y
CONFIG_SPIRAM_RODATA=y

#
# FreeRTOS Configuration
#
CONFIG_FREERTOS_HZ=1000
CONFIG_FREERTOS_UNICORE=n

#
# Task Watchdog — IDLE0 check disabled because CPU0 is saturated
# by WiFi (ESP-NOW) + espnow_master task. espnow_master feeds WDT
# explicitly via esp_task_wdt_add/reset for deadlock protection.
#
CONFIG_ESP_TASK_WDT_EN=y
CONFIG_ESP_TASK_WDT_INIT=y
CONFIG_ESP_TASK_WDT_TIMEOUT_S=5
CONFIG_ESP_TASK_WDT_CHECK_IDLE_TASK_CPU0=n
CONFIG_ESP_TASK_WDT_CHECK_IDLE_TASK_CPU1=y

#
# LVGL Configuration
#
CONFIG_LV_COLOR_DEPTH_16=y
CONFIG_LV_TICK_CUSTOM=y
# Route ALL LVGL allocations through our PSRAM-preferred heap_caps hooks
# (see main/lv_mem_psram.c). Internal RAM is only ~240KB on S3 and gets
# starved fast by big screens (e.g. BOOST cell-grid editor); PSRAM has 6MB+.
# CONFIG_LV_USE_BUILTIN_MALLOC is not set
# CONFIG_LV_USE_CLIB_MALLOC is not set
CONFIG_LV_USE_CUSTOM_MALLOC=y

#
# LCD Configuration
#
CONFIG_LCD_RGB_REFRESH_TASK_PERIOD_MS=16
CONFIG_LCD_RGB_RESTART_IN_VSYNC=y

#
# Compiler Options
#
CONFIG_COMPILER_OPTIMIZATION_PERF=y
CONFIG_COMPILER_OPTIMIZATION_ASSERTIONS_DISABLE=y

#
# Logging
#
CONFIG_LOG_DEFAULT_LEVEL_INFO=y
CONFIG_LOG_COLORS=y
CONFIG_LV_FONT_FMT_TXT_LARGE=y
```

## center/sdkconfig.defaults.modified
```kconfig
# ─────────────────────────────────────────────────────────────────────────────
# OpenDash Center Display — SDK Configuration Defaults
#
# Hardware: Waveshare ESP32-S3-Touch-LCD-4.3
# Resolution: 800×480 IPS LCD
# ─────────────────────────────────────────────────────────────────────────────

#
# Target Configuration
#
CONFIG_IDF_TARGET="esp32s3"

#
# Flash Configuration
#
CONFIG_ESPTOOLPY_FLASHSIZE_16MB=y
CONFIG_ESPTOOLPY_FLASHMODE_QIO=y
CONFIG_ESPTOOLPY_FLASHFREQ_80M=y

#
# Partition Table
#
CONFIG_PARTITION_TABLE_CUSTOM=y
CONFIG_PARTITION_TABLE_CUSTOM_FILENAME="partitions.csv"

#
# ESP32S3-Specific Configuration
#
CONFIG_ESP32S3_DEFAULT_CPU_FREQ_240=y
CONFIG_ESP32S3_DATA_CACHE_64KB=y
CONFIG_ESP32S3_DATA_CACHE_LINE_64B=y

#
# Memory Configuration
#
CONFIG_ESP_MAIN_TASK_STACK_SIZE=8192
CONFIG_SPIRAM=y
CONFIG_SPIRAM_MODE_OCT=y
CONFIG_SPIRAM_SPEED_80M=y
CONFIG_SPIRAM_RODATA=y

#
# FreeRTOS Configuration
#
CONFIG_FREERTOS_HZ=1000
CONFIG_FREERTOS_UNICORE=n

#
# Task Watchdog — IDLE0 check disabled because CPU0 is saturated
# by WiFi (ESP-NOW) + espnow_master task. espnow_master feeds WDT
# explicitly via esp_task_wdt_add/reset for deadlock protection.
#
CONFIG_ESP_TASK_WDT_EN=y
CONFIG_ESP_TASK_WDT_INIT=y
CONFIG_ESP_TASK_WDT_TIMEOUT_S=5
CONFIG_ESP_TASK_WDT_CHECK_IDLE_TASK_CPU0=n
CONFIG_ESP_TASK_WDT_CHECK_IDLE_TASK_CPU1=y

#
# LVGL Configuration
#
CONFIG_LV_COLOR_DEPTH_16=y
CONFIG_LV_TICK_CUSTOM=y
CONFIG_LV_MEM_SIZE_KILOBYTES=256
CONFIG_LV_MEM_POOL_EXPAND_SIZE_KILOBYTES=64

#
# LCD Configuration
#
CONFIG_LCD_RGB_REFRESH_TASK_PERIOD_MS=16
CONFIG_LCD_RGB_RESTART_IN_VSYNC=y

#
# Compiler Options
#
CONFIG_COMPILER_OPTIMIZATION_PERF=y
CONFIG_COMPILER_OPTIMIZATION_ASSERTIONS_DISABLE=y

#
# Logging
#
CONFIG_LOG_DEFAULT_LEVEL_INFO=y
CONFIG_LOG_COLORS=y
```

## gps/sdkconfig.defaults
```kconfig
# ─────────────────────────────────────────────────────────────────────────────
# OpenDash GPS / Telemetry Unit — SDK Configuration Defaults
#
# Hardware: Waveshare ESP32-S3-Touch-AMOLED-1.75
# Display: 466×466 CO5300 QSPI AMOLED
# Touch: CST9217 (I2C)
# GPS: LC76G (I2C addr 0x50)
# IMU: QMI8658 (I2C)
# ─────────────────────────────────────────────────────────────────────────────

#
# Target Configuration
#
CONFIG_IDF_TARGET="esp32s3"

#
# Flash Configuration
#
CONFIG_ESPTOOLPY_FLASHSIZE_16MB=y
CONFIG_ESPTOOLPY_FLASHMODE_QIO=y
CONFIG_ESPTOOLPY_FLASHFREQ_80M=y

#
# Partition Table
#
CONFIG_PARTITION_TABLE_CUSTOM=y
CONFIG_PARTITION_TABLE_CUSTOM_FILENAME="partitions.csv"

#
# ESP32S3-Specific Configuration
#
CONFIG_ESP32S3_DEFAULT_CPU_FREQ_240=y
CONFIG_ESP32S3_DATA_CACHE_64KB=y
CONFIG_ESP32S3_DATA_CACHE_LINE_64B=y

#
# Memory Configuration
#
CONFIG_ESP_MAIN_TASK_STACK_SIZE=8192
CONFIG_SPIRAM=y
CONFIG_SPIRAM_MODE_OCT=y
CONFIG_SPIRAM_SPEED_80M=y

#
# FreeRTOS Configuration
#
CONFIG_FREERTOS_HZ=1000
CONFIG_FREERTOS_UNICORE=n

#
# LVGL Configuration
#
CONFIG_LV_COLOR_DEPTH_24=y
CONFIG_LV_MEM_CUSTOM=y

#
# Waveshare BSP Configuration
#
CONFIG_BSP_I2C_NUM=0
CONFIG_BSP_I2C_FAST_MODE=y

#
# Display (QSPI CO5300)
#
CONFIG_BSP_LCD_TRANS_QUEUE_DEPTH=10

#
# SD Card
#
CONFIG_BSP_SD_MOUNT_POINT="/sdcard"

#
# Compiler Options
#
CONFIG_COMPILER_OPTIMIZATION_PERF=y
CONFIG_COMPILER_OPTIMIZATION_ASSERTIONS_DISABLE=y

#
# Logging
#
CONFIG_LOG_DEFAULT_LEVEL_INFO=y
CONFIG_LOG_COLORS=y

#
# Watchdog — disable CPU0 idle check (WiFi + ESP-NOW + sensor tasks load it)
#
CONFIG_ESP_TASK_WDT_CHECK_IDLE_TASK_CPU0=n


# ─── BLE OTA (centralised, see opendash_bt_ota_enter) ────────────────────────
CONFIG_BT_ENABLED=y
CONFIG_BT_NIMBLE_ENABLED=y
CONFIG_BT_NIMBLE_MAX_CONNECTIONS=1
CONFIG_BT_NIMBLE_ROLE_PERIPHERAL=y
CONFIG_BT_NIMBLE_ROLE_CENTRAL=n
CONFIG_BT_NIMBLE_ROLE_OBSERVER=n
CONFIG_BT_NIMBLE_ROLE_BROADCASTER=y
CONFIG_LV_FONT_FMT_TXT_LARGE=y
```

## left-right/sdkconfig.defaults
```kconfig
# ─────────────────────────────────────────────────────────────────────────────
# OpenDash Left/Right Gauges — SDK Configuration Defaults
#
# Hardware: Waveshare ESP32-S3-LCD-2.8C
# Resolution: 480×480 Round IPS LCD
# ─────────────────────────────────────────────────────────────────────────────

#
# Target Configuration
#
CONFIG_IDF_TARGET="esp32s3"

#
# Flash Configuration
#
CONFIG_ESPTOOLPY_FLASHSIZE_16MB=y
CONFIG_ESPTOOLPY_FLASHMODE_QIO=y
CONFIG_ESPTOOLPY_FLASHFREQ_80M=y

#
# Partition Table
#
CONFIG_PARTITION_TABLE_CUSTOM=n
CONFIG_PARTITION_TABLE_TWO_OTA=y

#
# ESP32S3-Specific Configuration
#
CONFIG_ESP32S3_DEFAULT_CPU_FREQ_240=y
CONFIG_ESP32S3_DATA_CACHE_64KB=y
CONFIG_ESP32S3_DATA_CACHE_LINE_64B=y

#
# Memory Configuration
#
CONFIG_ESP_MAIN_TASK_STACK_SIZE=8192
CONFIG_SPIRAM=y
CONFIG_SPIRAM_MODE_OCT=y
CONFIG_SPIRAM_SPEED_80M=y

#
# FreeRTOS Configuration
#
CONFIG_FREERTOS_HZ=1000
CONFIG_FREERTOS_UNICORE=n

#
# LVGL Configuration
#
CONFIG_LV_COLOR_DEPTH_16=y
CONFIG_LV_TICK_CUSTOM=y
CONFIG_LV_MEM_CUSTOM=y

#
# Compiler Options
#
CONFIG_COMPILER_OPTIMIZATION_PERF=y
CONFIG_COMPILER_OPTIMIZATION_ASSERTIONS_DISABLE=y

#
# Logging
#
CONFIG_LOG_DEFAULT_LEVEL_INFO=y
CONFIG_LOG_COLORS=y
```

## left/sdkconfig.defaults
```kconfig
# ─────────────────────────────────────────────────────────────────────────────
# OpenDash Left Gauge — SDK Configuration Defaults
#
# Hardware: Waveshare ESP32-S3-Touch-LCD-2.8C
# Display: 480x480 Round IPS LCD (ST7701S controller, RGB565 interface)
# Touch: GT911 capacitive touch over I2C
# ─────────────────────────────────────────────────────────────────────────────

#
# Target Configuration
#
CONFIG_IDF_TARGET="esp32s3"

#
# Flash Configuration (16MB onboard)
#
CONFIG_ESPTOOLPY_FLASHSIZE_16MB=y
CONFIG_ESPTOOLPY_FLASHMODE_QIO=y
CONFIG_ESPTOOLPY_FLASHFREQ_80M=y

#
# Partition Table (custom — 2MB app partitions for image data)
#
CONFIG_PARTITION_TABLE_CUSTOM=y
CONFIG_PARTITION_TABLE_CUSTOM_FILENAME="partitions.csv"
CONFIG_PARTITION_TABLE_FILENAME="partitions.csv"

#
# ESP32-S3 CPU & Cache
#
CONFIG_ESP32S3_DEFAULT_CPU_FREQ_240=y
CONFIG_ESP32S3_DATA_CACHE_64KB=y
CONFIG_ESP32S3_DATA_CACHE_LINE_64B=y

#
# PSRAM (8MB Octal SPI — required for LVGL frame buffer)
#
CONFIG_ESP_MAIN_TASK_STACK_SIZE=8192
CONFIG_SPIRAM=y
CONFIG_SPIRAM_MODE_OCT=y
CONFIG_SPIRAM_SPEED_80M=y

#
# FreeRTOS
#
CONFIG_FREERTOS_HZ=1000
CONFIG_FREERTOS_UNICORE=n

#
# Task Watchdog — disable IDLE0 check (CPU0 loaded by WiFi/ESP-NOW)
#
CONFIG_ESP_TASK_WDT_CHECK_IDLE_TASK_CPU0=n

#
# LVGL Configuration
#
CONFIG_LV_COLOR_DEPTH_16=y
CONFIG_LV_TICK_CUSTOM=y
CONFIG_LV_MEM_CUSTOM=y

#
# Compiler
#
CONFIG_COMPILER_OPTIMIZATION_PERF=y
CONFIG_COMPILER_OPTIMIZATION_ASSERTIONS_DISABLE=y

#
# Logging
#
CONFIG_LOG_DEFAULT_LEVEL_INFO=y
CONFIG_LOG_COLORS=y

# ─── BLE OTA (centralised, see opendash_bt_ota_enter) ────────────────────────
CONFIG_BT_ENABLED=y
CONFIG_BT_NIMBLE_ENABLED=y
CONFIG_BT_NIMBLE_MAX_CONNECTIONS=1
CONFIG_BT_NIMBLE_ROLE_PERIPHERAL=y
CONFIG_BT_NIMBLE_ROLE_CENTRAL=n
CONFIG_BT_NIMBLE_ROLE_OBSERVER=n
CONFIG_BT_NIMBLE_ROLE_BROADCASTER=y
# Peripheral Preferred Connection Parameters — BlueZ central reads these on
# connect when no explicit CPR was negotiated. Forces 32 s supervision so the
# link survives flash-write stalls and mouse/HOGP scheduler contention.
CONFIG_BT_NIMBLE_SVC_GAP_PPCP_MIN_CONN_INTERVAL=6
CONFIG_BT_NIMBLE_SVC_GAP_PPCP_MAX_CONN_INTERVAL=12
CONFIG_BT_NIMBLE_SVC_GAP_PPCP_SLAVE_LATENCY=0
CONFIG_BT_NIMBLE_SVC_GAP_PPCP_SUPERVISION_TMO=3200
CONFIG_BT_NIMBLE_LL_CFG_FEAT_LE_2M_PHY=y
CONFIG_BT_NIMBLE_ACL_BUF_COUNT=32
CONFIG_BT_NIMBLE_ACL_BUF_SIZE=517
CONFIG_BT_NIMBLE_MSYS1_BLOCK_COUNT=24
# Pin BT controller + NimBLE host to CPU1 so they don't fight the RGB DMA
# bounce-buffer task on CPU0. Without this, OTA links die at ~2-10s with HCI
# reason 0x08 because controller link-layer ISRs are starved.
CONFIG_BT_CTRL_PINNED_TO_CORE_1=y
CONFIG_BT_NIMBLE_PINNED_TO_CORE_1=y
CONFIG_LV_FONT_FMT_TXT_LARGE=y
```

## mos-4ch-a-pre-restore-2026-05-24/sdkconfig.defaults
```kconfig
# ─────────────────────────────────────────────────────────────────────────────
# OpenDash 4-Channel MOS FET A — SDK Configuration Defaults
#
# NOTE: Standard ESP32 (not ESP32-S3).
# GPIO assignments TBD — requires physical pinout discovery.
# ─────────────────────────────────────────────────────────────────────────────

CONFIG_IDF_TARGET="esp32"

# Flash
CONFIG_ESPTOOLPY_FLASHSIZE_4MB=y
CONFIG_ESPTOOLPY_FLASHMODE_QIO=y

# CPU
CONFIG_ESP32_DEFAULT_CPU_FREQ_240=y

# FreeRTOS
CONFIG_FREERTOS_HZ=1000

# Logging
CONFIG_LOG_DEFAULT_LEVEL_INFO=y
CONFIG_LOG_COLORS=y

# Brownout — DISABLED for FTDI-powered development
CONFIG_ESP_BROWNOUT_DET=n

# Watchdog
CONFIG_ESP_TASK_WDT_TIMEOUT_S=10
```

## relay-4ch-hd/sdkconfig.defaults
```kconfig
# ─────────────────────────────────────────────────────────────────────────────
# OpenDash 4-Channel HD Relay — SDK Configuration Defaults
#
# Hardware: ESP32 4-Channel HD Relay Module (LCTech)
# http://www.chinalctech.com/cpzx/Programmer/Relay_Module/788.html
#
# NOTE: This module uses a standard ESP32 (not ESP32-S3).
# GPIO assignments TBD — requires physical pinout discovery.
# ─────────────────────────────────────────────────────────────────────────────

#
# Target: Standard ESP32 (change if module is ESP32-S3)
#
CONFIG_IDF_TARGET="esp32"

#
# Flash
#
CONFIG_ESPTOOLPY_FLASHSIZE_4MB=y
CONFIG_ESPTOOLPY_FLASHMODE_QIO=y

#
# CPU
#
CONFIG_ESP32_DEFAULT_CPU_FREQ_240=y

#
# FreeRTOS
#
CONFIG_FREERTOS_HZ=1000

#
# Logging
#
CONFIG_LOG_DEFAULT_LEVEL_INFO=y
CONFIG_LOG_COLORS=y

# Brownout — DISABLED for FTDI-powered development
# FTDI USB can't supply enough current for ESP32 + relay board
# Re-enable when powered from vehicle 12V→5V supply
CONFIG_ESP_BROWNOUT_DET=n

#
# Watchdog
#
CONFIG_ESP_TASK_WDT_CHECK_IDLE_TASK_CPU0=n

# ─── BLE OTA (centralised, see opendash_bt_ota_enter) ────────────────────────
CONFIG_BT_ENABLED=y
CONFIG_BT_NIMBLE_ENABLED=y
CONFIG_BT_NIMBLE_MAX_CONNECTIONS=1
CONFIG_BT_NIMBLE_ROLE_PERIPHERAL=y
CONFIG_BT_NIMBLE_ROLE_CENTRAL=n
CONFIG_BT_NIMBLE_ROLE_OBSERVER=n
CONFIG_BT_NIMBLE_ROLE_BROADCASTER=y
CONFIG_LV_FONT_FMT_TXT_LARGE=y
```

## relay-8ch-a/sdkconfig.defaults
```kconfig
# ─────────────────────────────────────────────────────────────────────────────
# OpenDash 8-Channel Relay A — SDK Configuration Defaults
#
# NOTE: Standard ESP32 (not ESP32-S3).
# GPIO: 32,33,25,26,27,14,12,13 (8 channels, active-low)
# Programming: FTDI /dev/ttyUSB1, then BLE OTA
# ─────────────────────────────────────────────────────────────────────────────

CONFIG_IDF_TARGET="esp32"

# Flash
CONFIG_ESPTOOLPY_FLASHSIZE_4MB=y
CONFIG_ESPTOOLPY_FLASHMODE_QIO=y

# Partition table — custom OTA layout
CONFIG_PARTITION_TABLE_CUSTOM=y
CONFIG_PARTITION_TABLE_CUSTOM_FILENAME="partitions.csv"

# CPU
CONFIG_ESP32_DEFAULT_CPU_FREQ_240=y

# FreeRTOS
CONFIG_FREERTOS_HZ=1000

# Logging
CONFIG_LOG_DEFAULT_LEVEL_INFO=y
CONFIG_LOG_COLORS=y

# Watchdog
CONFIG_ESP_TASK_WDT_TIMEOUT_S=10

# Bluetooth (for OTA mode)
CONFIG_BT_ENABLED=y
CONFIG_BT_NIMBLE_ENABLED=y
CONFIG_BT_NIMBLE_MAX_CONNECTIONS=1
CONFIG_BT_NIMBLE_ROLE_PERIPHERAL=y
CONFIG_BT_NIMBLE_ROLE_CENTRAL=n
CONFIG_BT_NIMBLE_ROLE_OBSERVER=n
CONFIG_BT_NIMBLE_ROLE_BROADCASTER=y

# Brownout — DISABLED for FTDI-powered development
# FTDI USB can't supply enough current for ESP32-WROOM-32E + relay board
# Re-enable when powered from vehicle 12V→5V supply
CONFIG_ESP_BROWNOUT_DET=n

# OTA support
CONFIG_APP_PROJECT_VER_FROM_CONFIG=y
CONFIG_APP_PROJECT_VER="0.1.0"
```
